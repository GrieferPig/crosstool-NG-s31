## samples/riscv32-esp32p4v13-linux-uclibc/buildroot_defconfig
```kconfig
# Buildroot cb857ba4 (2026.05.1); export P4_SDK=/absolute/path/to/SDK.
BR2_REPRODUCIBLE=y
BR2_riscv=y
BR2_riscv_custom=y
BR2_RISCV_32=y
BR2_RISCV_ISA_RVM=y
BR2_RISCV_ISA_RVA=y
BR2_RISCV_ISA_RVC=y
BR2_RISCV_ISA_EXTRA="xespv2p1"
# BR2_RISCV_USE_MMU is not set
BR2_RISCV_ABI_ILP32=y
BR2_BINFMT_FLAT=y
BR2_TOOLCHAIN_EXTERNAL=y
BR2_TOOLCHAIN_EXTERNAL_CUSTOM=y
BR2_TOOLCHAIN_EXTERNAL_PREINSTALLED=y
BR2_TOOLCHAIN_EXTERNAL_PATH="$(P4_SDK)"
BR2_TOOLCHAIN_EXTERNAL_CUSTOM_PREFIX="riscv32-esp32p4v13-linux-uclibc"
BR2_TOOLCHAIN_EXTERNAL_GCC_15=y
BR2_TOOLCHAIN_EXTERNAL_HEADERS_6_12=y
BR2_TOOLCHAIN_EXTERNAL_CUSTOM_UCLIBC=y
BR2_TOOLCHAIN_EXTERNAL_HAS_THREADS=y
BR2_TOOLCHAIN_EXTERNAL_HAS_THREADS_DEBUG=y
# BR2_TOOLCHAIN_EXTERNAL_HAS_THREADS_NPTL is not set
BR2_TOOLCHAIN_EXTERNAL_HAS_SSP=y
BR2_STATIC_LIBS=y
BR2_OPTIMIZE_S=y
BR2_TARGET_GENERIC_HOSTNAME="esp32-p4"
BR2_TARGET_GENERIC_ISSUE="ESP32-P4 rev1.3 Linux (Buildroot)"
BR2_TARGET_GENERIC_GETTY_PORT="ttyS0"
BR2_TARGET_GENERIC_GETTY_BAUDRATE_115200=y
BR2_SYSTEM_DHCP=""
# BR2_TARGET_GENERIC_REMOUNT_ROOTFS_RW is not set
BR2_ROOTFS_DEVICE_CREATION_DYNAMIC_DEVTMPFS=y
BR2_TARGET_ROOTFS_CPIO=y
# BR2_TARGET_ROOTFS_TAR is not set
```
